/dts-v1/;
/plugin/;

/ {
        compatible = "brcm,bcm2835";

        fragment@0 {
                target = <&chosen>;
                frag0:  __overlay__ {
                };
        };

		__overrides__ {
			append = <&frag0>, "bootargs";
		};
};
